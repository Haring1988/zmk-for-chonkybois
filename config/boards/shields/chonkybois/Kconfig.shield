## config/boards/shields/chonkybois/Kconfig.shield
```kconfig
# Copyright (c) 2020 The ZMK Contributors
# SPDX-License-Identifier: MIT

config SHIELD_CHONKYBOIS_CENTRAL_DONGLE
    def_bool $(shields_list_contains,chonkybois_central_dongle)

config SHIELD_CHONKYBOIS_CENTRAL_LEFT
    def_bool $(shields_list_contains,chonkybois_central_left)
    
config SHIELD_CHONKYBOIS_PERIPHERAL_LEFT
    def_bool $(shields_list_contains,chonkybois_peripheral_left)

config SHIELD_CHONKYBOIS_PERIPHERAL_RIGHT
    def_bool $(shields_list_contains,chonkybois_peripheral_right)
```
